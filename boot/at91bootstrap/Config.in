## boot/at91bootstrap/Config.in
```kconfig
config BR2_TARGET_AT91BOOTSTRAP
	depends on BR2_arm926t
	bool "AT91 Bootstrap"
	help
	  AT91Bootstrap is the Second level bootloader for the Atmel AT91SoC
	  It integrates algorithms for:
	  - Device initialization such as clock configuration, PIO settings...
	  - Peripheral drivers such as PIO, PMC or SDRAMC...
	  - Physical media algorithm such as DataFlash, NANDFlash, SD Card...

choice
	prompt "Select File Name Configure Mode"
	depends on BR2_TARGET_AT91BOOTSTRAP
	default BR2_AT91BOOTSTRAP_CONFIG_FILENAME

config BR2_AT91BOOTSTRAP_CONFIG_FILENAME
	bool "Configure Config File Name"

config BR2_AT91BOOTSTRAP_INPUT_FILENAME
	bool "Input Config File Name"

endchoice

menu "Configure Config File Name"
	depends on BR2_AT91BOOTSTRAP_CONFIG_FILENAME

config BR2_AT91BOOTSTRAP_BOARD_NAME
	string "Board Name to configure"
	default "at91sam9g20ek"
	help
	  Input the board name to configure.

choice
	prompt "Select Booting Physical Media"
	default BS2_AT91BOOTSTRAP_NANDFlash

config BR2_AT91BOOTSTRAP_NANDFLASH
	bool "NandFLash"

config BR2_AT91BOOTSTRAP_DATAFLASH
	bool "DataFlash"

config BR2_AT91BOOTSTRAP_SDCARD
	bool "SD Card"

endchoice

choice
	prompt "Select Booting Image"
	default BR2_AT91BOOTSTRAP_UBOOT

config BR2_AT91BOOTSTRAP_UBOOT
	bool "u-boot"

config BR2_AT91BOOTSTRAP_LINUX
	bool "linux"

config BR2_AT91BOOTSTRAP_LINUX_DT
	bool "linux + dt"

endchoice
endmenu

config BR2_AT91BOOTSTRAP_INPUT_CONFIG_FILENAME
	string "Input Config File Name"
	default "at91sam9g20eknf_uboot_defconfig"
	depends on BR2_AT91BOOTSTRAP_INPUT_FILENAME
	help
	  Input at91bootstrap default config file name.
	  The default configuration file is located at
	  board/<ek board name>/ in at91bootstrap tree.
```

## configs/at91sam9_defconfig
```kconfig
BR2_arm=y
BR2_arm926t=y
BR2_JLEVEL=13
BR2_CCACHE=y
BR2_OPTIMIZE_3=y
BR2_TOOLCHAIN_EXTERNAL=y
BR2_TARGET_OPTIMIZATION=" -pipe"
BR2_ROOTFS_DEVICE_CREATION_DYNAMIC_UDEV=y
BR2_PACKAGE_BUSYBOX_CONFIG="package/busybox/busybox-at91sam9.config"
BR2_PACKAGE_ALSA_UTILS=y
BR2_PACKAGE_ALSA_UTILS_ALSACONF=y
BR2_PACKAGE_ALSA_UTILS_AMIXER=y
BR2_PACKAGE_ALSA_UTILS_APLAY=y
BR2_PACKAGE_GSTREAMER=y
BR2_PACKAGE_GST_FFMPEG=y
BR2_PACKAGE_GST_PLUGINS_GOOD=y
BR2_PACKAGE_GST_PLUGINS_GOOD_JPEG=y
BR2_PACKAGE_GST_PLUGINS_GOOD_PNG=y
BR2_PACKAGE_GST_PLUGINS_GOOD_PLUGIN_VIDEOFILTER=y
BR2_PACKAGE_GST_PLUGINS_GOOD_PLUGIN_V4L2=y
BR2_PACKAGE_GST_PLUGINS_BAD=y
BR2_PACKAGE_GST_PLUGINS_BAD_PLUGIN_MPEGDEMUX=y
BR2_PACKAGE_GST_PLUGINS_BAD_PLUGIN_MPEGTSDEMUX=y
BR2_PACKAGE_GST_PLUGINS_BAD_PLUGIN_DIRECTFB=y
BR2_PACKAGE_GST_PLUGINS_BAD_PLUGIN_FBDEV=y
BR2_PACKAGE_GST_PLUGINS_UGLY=y
BR2_PACKAGE_GST_PLUGINS_UGLY_PLUGIN_MPEG2DEC=y
BR2_PACKAGE_MADPLAY=y
BR2_PACKAGE_BZIP2=y
# BR2_PACKAGE_DIRECTFB_LINUXINPUT is not set
# BR2_PACKAGE_DIRECTFB_KEYBOARD is not set
# BR2_PACKAGE_DIRECTFB_PS2MOUSE is not set
# BR2_PACKAGE_DIRECTFB_SERIALMOUSE is not set
# BR2_PACKAGE_DIRECTFB_TSLIB is not set
BR2_PACKAGE_DIRECTFB_EXAMPLES=y
BR2_PACKAGE_DIRECTFB_EXAMPLES_FIRE=y
BR2_PACKAGE_DIRECTFB_EXAMPLES_PALETTE=y
BR2_PACKAGE_DIRECTFB_EXAMPLES_PARTICLE=y
BR2_PACKAGE_DIRECTFB_EXAMPLES_VIDEO_PARTICLE=y
BR2_PACKAGE_LIBERATION=y
BR2_PACKAGE_E2FSPROGS=y
BR2_PACKAGE_FBV=y
BR2_PACKAGE_MTD=y
BR2_PACKAGE_I2C_TOOLS=y
BR2_PACKAGE_RNG_TOOLS=y
BR2_PACKAGE_USBUTILS=y
BR2_PACKAGE_USBUTILS_ZLIB=y
BR2_PACKAGE_FONTCONFIG=y
BR2_PACKAGE_PIXMAN=y
BR2_PACKAGE_TSLIB=y
BR2_PACKAGE_ETHTOOL=y
BR2_PACKAGE_IPERF=y
BR2_PACKAGE_IPROUTE2=y
BR2_PACKAGE_MII_DIAG=y
BR2_PACKAGE_OPENSSH=y
BR2_PACKAGE_PORTMAP=y
BR2_PACKAGE_WIRELESS_TOOLS=y
BR2_PACKAGE_WPA_SUPPLICANT=y
BR2_PACKAGE_WPA_SUPPLICANT_EAP=y
BR2_TARGET_ROOTFS_JFFS2=y
BR2_TARGET_ROOTFS_JFFS2_NOCLEANMARKER=y
BR2_TARGET_ROOTFS_UBIFS=y
BR2_TARGET_ROOTFS_UBIFS_LEBSIZE=0x1f000
BR2_TARGET_ROOTFS_UBI=y
BR2_TARGET_ROOTFS_UBI_SUBSIZE=2048
```

## configs/at91sam9x5ek_defconfig
```kconfig
BR2_arm=y
BR2_arm926t=y
BR2_CCACHE=y
BR2_KERNEL_HEADERS_VERSION=y
BR2_DEFAULT_KERNEL_VERSION="2.6.39"
BR2_TARGET_OPTIMIZATION="-Os -pipe"
BR2_TOOLCHAIN_BUILDROOT_LARGEFILE=y
BR2_TOOLCHAIN_BUILDROOT_INET_RPC=y
BR2_TOOLCHAIN_BUILDROOT_WCHAR=y
BR2_TOOLCHAIN_BUILDROOT_CXX=y
BR2_TARGET_GENERIC_HOSTNAME="AT91SAM9"
BR2_ROOTFS_POST_BUILD_SCRIPT="board/atmel/at91sam9x5ek/post-build.sh"
BR2_PACKAGE_ALSA_UTILS=y
BR2_PACKAGE_ALSA_UTILS_ALSACONF=y
BR2_PACKAGE_ALSA_UTILS_AMIXER=y
BR2_PACKAGE_ALSA_UTILS_APLAY=y
BR2_PACKAGE_ALSA_UTILS_SPEAKER_TEST=y
BR2_PACKAGE_MADPLAY=y
BR2_PACKAGE_BZIP2=y
BR2_PACKAGE_I2C_TOOLS=y
BR2_PACKAGE_UDEV=y
BR2_PACKAGE_BRIDGE=y
BR2_PACKAGE_CAN_UTILS=y
BR2_PACKAGE_DROPBEAR=y
BR2_PACKAGE_ETHTOOL=y
BR2_PACKAGE_IPERF=y
BR2_PACKAGE_IPROUTE2=y
BR2_PACKAGE_IPTABLES=y
BR2_PACKAGE_LRZSZ=y
BR2_PACKAGE_MII_DIAG=y
BR2_PACKAGE_PORTMAP=y
BR2_PACKAGE_WIRELESS_TOOLS=y
BR2_PACKAGE_WIRELESS_TOOLS_LIB=y
BR2_PACKAGE_WPA_SUPPLICANT=y
BR2_PACKAGE_WPA_SUPPLICANT_EAP=y
BR2_PACKAGE_FILE=y
BR2_PACKAGE_WHICH=y
BR2_TARGET_ROOTFS_JFFS2=y
BR2_TARGET_ROOTFS_JFFS2_FLASH_64=y
BR2_TARGET_ROOTFS_JFFS2_NOCLEANMARKER=y
BR2_TARGET_ROOTFS_UBIFS=y
BR2_TARGET_ROOTFS_UBIFS_LEBSIZE=0x1f000
BR2_TARGET_ROOTFS_UBIFS_MAXLEBCNT=1984
BR2_TARGET_ROOTFS_UBI=y
BR2_TARGET_ROOTFS_UBI_SUBSIZE=2048
BR2_TARGET_ROOTFS_TAR_BZIP2=y
BR2_LINUX_KERNEL=y
BR2_LINUX_KERNEL_CUSTOM_VERSION=y
BR2_LINUX_KERNEL_CUSTOM_VERSION_VALUE="2.6.39"
BR2_LINUX_KERNEL_PATCH="ftp://www.linux4sam.org/pub/linux/2.6.39-at91/2.6.39-at91-exp.tar.gz"
BR2_LINUX_KERNEL_DEFCONFIG="at91sam9x5ek"
```

## configs/sama5d3_defconfig
```kconfig
BR2_arm=y
BR2_cortex_a5=y
BR2_ARM_EABIHF=y
BR2_ARM_FPU_VFPV4D16=y
BR2_ARM_INSTRUCTIONS_THUMB2=y
BR2_TOOLCHAIN_EXTERNAL=y
BR2_ROOTFS_DEVICE_CREATION_DYNAMIC_UDEV=y
BR2_BUSYBOX_VERSION_1_20_X=y
BR2_PACKAGE_BUSYBOX_SHOW_OTHERS=y
BR2_PACKAGE_ALSA_UTILS=y
BR2_PACKAGE_ALSA_UTILS_ALSACONF=y
BR2_PACKAGE_ALSA_UTILS_AMIXER=y
BR2_PACKAGE_ALSA_UTILS_APLAY=y
BR2_PACKAGE_ALSA_UTILS_SPEAKER_TEST=y
BR2_PACKAGE_FFMPEG_NONFREE=y
BR2_PACKAGE_GSTREAMER=y
BR2_PACKAGE_GST_PLUGINS_BASE_PLUGIN_VIDEORATE=y
BR2_PACKAGE_GST_PLUGINS_BASE_PLUGIN_ALSA=y
BR2_PACKAGE_GST_PLUGINS_GOOD=y
BR2_PACKAGE_GST_PLUGINS_GOOD_JPEG=y
BR2_PACKAGE_GST_PLUGINS_GOOD_PNG=y
BR2_PACKAGE_GST_PLUGINS_GOOD_PLUGIN_VIDEOFILTER=y
BR2_PACKAGE_GST_PLUGINS_GOOD_PLUGIN_V4L2=y
BR2_PACKAGE_GST_PLUGINS_BAD=y
BR2_PACKAGE_GST_PLUGINS_BAD_PLUGIN_COLORSPACE=y
BR2_PACKAGE_GST_PLUGINS_BAD_PLUGIN_MPEGDEMUX=y
BR2_PACKAGE_GST_PLUGINS_BAD_PLUGIN_MPEGTSDEMUX=y
BR2_PACKAGE_GST_PLUGINS_BAD_PLUGIN_VIDEOFILTERS=y
BR2_PACKAGE_GST_PLUGINS_BAD_PLUGIN_DIRECTFB=y
BR2_PACKAGE_GST_PLUGINS_BAD_PLUGIN_FBDEV=y
BR2_PACKAGE_GST_PLUGINS_UGLY=y
BR2_PACKAGE_GST_PLUGINS_UGLY_PLUGIN_MPEG2DEC=y
BR2_PACKAGE_GST_FFMPEG=y
BR2_PACKAGE_MPG123=y
BR2_PACKAGE_MPLAYER=y
BR2_PACKAGE_BZIP2=y
BR2_PACKAGE_GZIP=y
BR2_PACKAGE_XZ=y
BR2_PACKAGE_MEMSTAT=y
BR2_PACKAGE_NETPERF=y
BR2_PACKAGE_STRACE=y
BR2_PACKAGE_TAR=y
BR2_PACKAGE_MTD=y
BR2_PACKAGE_MTD_FLASH_OTP_DUMP=y
BR2_PACKAGE_MTD_FLASH_OTP_INFO=y
BR2_PACKAGE_MTD_MKFSJFFS2=y
BR2_PACKAGE_FBV=y
BR2_PACKAGE_QT=y
BR2_PACKAGE_DEVMEM2=y
BR2_PACKAGE_EEPROG=y
BR2_PACKAGE_EVTEST=y
BR2_PACKAGE_I2C_TOOLS=y
BR2_PACKAGE_IOSTAT=y
BR2_PACKAGE_LM_SENSORS=y
BR2_PACKAGE_RNG_TOOLS=y
BR2_PACKAGE_SETSERIAL=y
BR2_PACKAGE_STATSERIAL=y
BR2_PACKAGE_USBUTILS=y
BR2_PACKAGE_USBUTILS_ZLIB=y
BR2_PACKAGE_PYTHON=y
BR2_PACKAGE_PYTHON_CURSES=y
BR2_PACKAGE_PYTHON_READLINE=y
BR2_PACKAGE_PYTHON_NETIFACES=y
BR2_PACKAGE_PYTHON_SERIAL=y
BR2_PACKAGE_SQLITE=y
BR2_PACKAGE_ZXING=y
BR2_PACKAGE_BRIDGE_UTILS=y
BR2_PACKAGE_CAN_UTILS=y
BR2_PACKAGE_DROPBEAR=y
BR2_PACKAGE_EBTABLES=y
BR2_PACKAGE_ETHTOOL=y
BR2_PACKAGE_IPERF=y
BR2_PACKAGE_IPROUTE2=y
BR2_PACKAGE_IPTABLES=y
BR2_PACKAGE_IW=y
BR2_PACKAGE_LRZSZ=y
BR2_PACKAGE_MACCHANGER=y
BR2_PACKAGE_MII_DIAG=y
BR2_PACKAGE_OPENSSH=y
BR2_PACKAGE_PORTMAP=y
BR2_PACKAGE_TCPDUMP=y
BR2_PACKAGE_WIRELESS_TOOLS=y
BR2_PACKAGE_WPA_SUPPLICANT=y
BR2_PACKAGE_WPA_SUPPLICANT_EAP=y
BR2_PACKAGE_WPA_SUPPLICANT_CLI=y
BR2_PACKAGE_WPA_SUPPLICANT_PASSPHRASE=y
BR2_PACKAGE_WPA_SUPPLICANT_AP_SUPPORT=y
BR2_PACKAGE_WPA_SUPPLICANT_WPS=y
BR2_PACKAGE_BASH=y
BR2_PACKAGE_FILE=y
BR2_PACKAGE_CPULOAD=y
BR2_PACKAGE_VIM=y
BR2_TARGET_ROOTFS_CPIO=y
BR2_TARGET_ROOTFS_JFFS2=y
BR2_TARGET_ROOTFS_JFFS2_NANDFLASH_2K_128K=y
BR2_TARGET_ROOTFS_UBIFS=y
BR2_TARGET_ROOTFS_UBIFS_LEBSIZE=0x1f000
BR2_TARGET_ROOTFS_UBI=y
BR2_TARGET_ROOTFS_UBI_SUBSIZE=2048
```

## configs/sama5d3db_defconfig
```kconfig
BR2_arm=y
BR2_cortex_a5=y
BR2_JLEVEL=13
BR2_CCACHE=y
BR2_OPTIMIZE_3=y
BR2_GCC_VERSION_4_6_X=y
BR2_EXTRA_GCC_CONFIG_OPTIONS="--with-float=hard --with-fpu=vfpv4-d16"
# BR2_SOFT_FLOAT is not set
BR2_TARGET_OPTIMIZATION="-pipe -mcpu=cortex-a5 -mfpu=vfpv4-d16 -mfloat-abi=hard"
BR2_TOOLCHAIN_BUILDROOT_LARGEFILE=y
BR2_TOOLCHAIN_BUILDROOT_INET_IPV6=y
BR2_TOOLCHAIN_BUILDROOT_INET_RPC=y
BR2_TOOLCHAIN_BUILDROOT_WCHAR=y
BR2_TOOLCHAIN_BUILDROOT_CXX=y
BR2_VFP_FLOAT=y
BR2_ROOTFS_DEVICE_CREATION_DYNAMIC_UDEV=y
BR2_PACKAGE_BZIP2=y
BR2_PACKAGE_BONNIE=y
BR2_PACKAGE_LMBENCH=y
BR2_PACKAGE_NETPERF=y
BR2_PACKAGE_E2FSPROGS=y
BR2_PACKAGE_OPENSSL=y
BR2_PACKAGE_FONTCONFIG=y
BR2_PACKAGE_JPEG=y
BR2_PACKAGE_LIBPNG=y
BR2_PACKAGE_PIXMAN=y
BR2_PACKAGE_LIBFFI=y
BR2_PACKAGE_LIBGLIB2=y
BR2_PACKAGE_ETHTOOL=y
BR2_PACKAGE_IPERF=y
BR2_PACKAGE_MII_DIAG=y
BR2_LINUX_KERNEL=y
BR2_LINUX_KERNEL_CUSTOM_GIT=y
BR2_LINUX_KERNEL_CUSTOM_GIT_REPO_URL="git://rfolxts01.rfo.atmel.com/linux"
BR2_LINUX_KERNEL_CUSTOM_GIT_VERSION="sama5d3_M2"
BR2_LINUX_KERNEL_DEFCONFIG="sama5d3db"
BR2_LINUX_KERNEL_ZIMAGE=y
```

## configs/sama5d3ek_defconfig
```kconfig
BR2_arm=y
BR2_cortex_a5=y
BR2_JLEVEL=13
BR2_CCACHE=y
BR2_OPTIMIZE_3=y
BR2_GCC_VERSION_4_6_X=y
BR2_EXTRA_GCC_CONFIG_OPTIONS="--with-float=hard --with-fpu=vfpv4-d16"
# BR2_SOFT_FLOAT is not set
BR2_TARGET_OPTIMIZATION="-pipe -mcpu=cortex-a5 -mfpu=vfpv4-d16 -mfloat-abi=hard"
BR2_TOOLCHAIN_BUILDROOT_LARGEFILE=y
BR2_TOOLCHAIN_BUILDROOT_INET_IPV6=y
BR2_TOOLCHAIN_BUILDROOT_INET_RPC=y
BR2_TOOLCHAIN_BUILDROOT_WCHAR=y
BR2_TOOLCHAIN_BUILDROOT_CXX=y
BR2_VFP_FLOAT=y
BR2_ROOTFS_DEVICE_CREATION_DYNAMIC_UDEV=y
BR2_PACKAGE_GSTREAMER=y
BR2_PACKAGE_GST_FFMPEG=y
BR2_PACKAGE_GST_PLUGINS_GOOD=y
BR2_PACKAGE_GST_PLUGINS_GOOD_JPEG=y
BR2_PACKAGE_GST_PLUGINS_GOOD_PNG=y
BR2_PACKAGE_GST_PLUGINS_GOOD_PLUGIN_VIDEOFILTER=y
BR2_PACKAGE_GST_PLUGINS_BAD=y
BR2_PACKAGE_GST_PLUGINS_BAD_PLUGIN_MPEGDEMUX=y
BR2_PACKAGE_GST_PLUGINS_BAD_PLUGIN_MPEGTSDEMUX=y
BR2_PACKAGE_GST_PLUGINS_BAD_PLUGIN_DIRECTFB=y
BR2_PACKAGE_GST_PLUGINS_BAD_PLUGIN_FBDEV=y
BR2_PACKAGE_GST_PLUGINS_UGLY=y
BR2_PACKAGE_GST_PLUGINS_UGLY_PLUGIN_MPEG2DEC=y
BR2_PACKAGE_BZIP2=y
BR2_PACKAGE_BONNIE=y
BR2_PACKAGE_LMBENCH=y
BR2_PACKAGE_NETPERF=y
BR2_PACKAGE_MAKE=y
BR2_PACKAGE_DIRECTFB_MULTI=y
# BR2_PACKAGE_DIRECTFB_LINUXINPUT is not set
# BR2_PACKAGE_DIRECTFB_KEYBOARD is not set
# BR2_PACKAGE_DIRECTFB_PS2MOUSE is not set
# BR2_PACKAGE_DIRECTFB_SERIALMOUSE is not set
# BR2_PACKAGE_DIRECTFB_TSLIB is not set
BR2_PACKAGE_DIRECTFB_EXAMPLES=y
BR2_PACKAGE_DIRECTFB_EXAMPLES_FIRE=y
BR2_PACKAGE_DIRECTFB_EXAMPLES_PALETTE=y
BR2_PACKAGE_DIRECTFB_EXAMPLES_PARTICLE=y
BR2_PACKAGE_DIRECTFB_EXAMPLES_VIDEO_PARTICLE=y
BR2_PACKAGE_LIBERATION=y
BR2_PACKAGE_E2FSPROGS=y
BR2_PACKAGE_MICROPERL=y
BR2_PACKAGE_OPENSSL=y
BR2_PACKAGE_FONTCONFIG=y
BR2_PACKAGE_PIXMAN=y
BR2_PACKAGE_LIBFFI=y
BR2_PACKAGE_ETHTOOL=y
BR2_PACKAGE_IPERF=y
BR2_PACKAGE_MII_DIAG=y
BR2_TARGET_ROOTFS_EXT2=y
BR2_LINUX_KERNEL=y
BR2_LINUX_KERNEL_CUSTOM_GIT=y
BR2_LINUX_KERNEL_CUSTOM_GIT_REPO_URL="git://rfolxts01.rfo.atmel.com/linux"
BR2_LINUX_KERNEL_CUSTOM_GIT_VERSION="sama5d3_M2"
BR2_LINUX_KERNEL_DEFCONFIG="sama5d3ek"
BR2_LINUX_KERNEL_ZIMAGE=y
```
